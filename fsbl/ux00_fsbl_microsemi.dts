/ {
	soc {
                pci@2030000000 {
                        #address-cells = <3>;
                        #interrupt-cells = <1>;
                        #size-cells = <2>;
                        compatible = "ms-pf,axi-pcie-host";
                        device_type = "pci";
                        bus-range = <0x01 0x7f>;
                        interrupt-map = <0 0 0 1 &ms_pcie_intc 1 0 0 0 2 &ms_pcie_intc 2 0 0 0 3 &ms_pcie_intc 3 0 0 0 4 &ms_pcie_intc 4>;
                        interrupt-map-mask = <0 0 0 7>;
                        interrupt-parent = <&L4>;
                        interrupts = <32>;
                        ranges = <0x2000000 0x0 0x40000000 0x0 0x40000000 0x0 0x20000000>;
                        reg = <0x20 0x30000000 0x0 0x4000000 0x20 0x0 0x0 0x100000>;
                        reg-names = "control", "apb";
                        ms_pcie_intc: interrupt-controller {
                                #address-cells = <0>;
                                #interrupt-cells = <1>;
                                interrupt-controller;
                        };
                };
	};
};
